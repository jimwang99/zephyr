## CMakeLists.txt
```
# SPDX-License-Identifier: Apache-2.0

cmake_minimum_required(VERSION 3.20.0)

find_package(Zephyr REQUIRED HINTS $ENV{ZEPHYR_BASE})
project(circular-buffer)

target_sources(app PRIVATE src/main.cpp src/circular_buffer.cpp)
```

## prj.conf
```kconfig
CONFIG_CPP=y
CONFIG_REQUIRES_FULL_LIBCPP=n
CONFIG_SYS_CLOCK_TICKS_PER_SEC=100

CONFIG_HEAP_MEM_POOL_SIZE=4096

CONFIG_ZTEST=y
CONFIG_DEBUG=y
CONFIG_LOG=y
```

## src/main.cpp
```c
#include <zephyr/kernel.h>
#include <zephyr/logging/log.h>
#include <zephyr/ztest.h>

LOG_MODULE_REGISTER(testsuite_basic_main);

#include "circular_buffer.hpp"
// #include "event_logger.hpp"

K_THREAD_STACK_DEFINE(stack1, 1024);
K_THREAD_STACK_DEFINE(stack2, 1024);

ZTEST(basic, test_circular_buffer)
{
	TestCircularBuffer();
}

ZTEST(basic, test_circular_buffer_multithreading)
{
	TestCircularBufferMultithreading(stack1, stack2);
}

// ZTEST(basic, test_log_and_get)
// {
// 	const int NUM_ENTRY = 16;
// 	EventLogger evlog(NUM_ENTRY);

// 	LOG_INF("Testing adding events to the EventLogger");
// 	zassert_equal(evlog.log(EventId::START_UP), true);
// 	k_sleep(K_CYC(1000));
// 	zassert_equal(evlog.log(EventId::START_READING), true);
// 	k_sleep(K_CYC(1000));
// 	zassert_equal(evlog.log(EventId::START_WRITING), true);
// 	k_sleep(K_CYC(1000));
// 	zassert_equal(evlog.log(EventId::STOP_READING), true);
// 	k_sleep(K_CYC(1000));
// 	zassert_equal(evlog.log(EventId::STOP_WRITING), true);
// 	k_sleep(K_CYC(1000));
// 	zassert_equal(evlog.log(EventId::SHUT_DOWN), true);
// }

ZTEST_SUITE(basic, NULL, NULL, NULL, NULL, NULL);
```

## src/circular_buffer.cpp
```c
#include <zephyr/logging/log.h>
#include <zephyr/ztest.h>

#include "circular_buffer.hpp"

LOG_MODULE_REGISTER(circular_buffer);

void TestCircularBuffer()
{
	const int NUM_ENTRY = 3;
	CircularBuffer<int> cb(NUM_ENTRY);
	cb.Open();

	LOG_INF("Testing writing CircularBuffer");
	for (int i = 0; i < NUM_ENTRY; ++i) {
		auto err = cb.Write(i);
		zassert_equal(err, 0);
	}
	for (int i = 0; i < NUM_ENTRY; ++i) {
		auto err = cb.Write(i);
		zassert_equal(err, -ENOBUFS);
	}

	LOG_INF("Testing reading CircularBuffer");
	for (int i = 0; i < NUM_ENTRY; ++i) {
		int j;
		auto err = cb.Read(j);
		zassert_equal(err, 0);
		zassert_equal(i, j);
	}
	for (int i = 0; i < NUM_ENTRY; ++i) {
		int j;
		auto err = cb.Read(j);
		zassert_equal(err, -ENODATA);
	}

	cb.Close();
}

void ThreadProducer(void *circular_buffer, void *unused2, void *unused3)
{
	LOG_INF("ThreadProducer starts ...");
	// k_sleep(K_MSEC(1));
	// LOG_INF("sleep done");
	auto cb = reinterpret_cast<CircularBuffer<int> *>(circular_buffer);
	// for (int i = 0; i < 20; ++i) {
	// 	while (cb->Write(i) == -ENOBUFS) {
	// 		// k_sleep(K_CYC(1000));
	// 	}
	// 	LOG_DBG("Write %d", i);
	// }
	LOG_INF("ThreadProducer ends ...");
}

void ThreadConsumer(void *circular_buffer, void *unused2, void *unused3)
{
	LOG_INF("ThreadConsumer starts ...");
	auto cb = reinterpret_cast<CircularBuffer<int> *>(circular_buffer);
	// for (int i = 0; i < 20; ++i) {
	// 	int j;
	// 	while (cb->Read(j) == -ENODATA) {
	// 		// k_sleep(K_CYC(1000));
	// 	}
	// 	LOG_DBG("Read %d", i);
	// 	zassert_equal(i, j);
	// }
	LOG_INF("ThreadConsumer ends ...");
}

void TestCircularBufferMultithreading(k_thread_stack_t *stack1, k_thread_stack_t *stack2)
{
	zassert_not_null(stack1);
	zassert_not_null(stack2);
	// create circular buffer
	const int NUM_ENTRY = 3;
	CircularBuffer<int> cb(NUM_ENTRY);
	cb.Open();

	// create thread
	k_thread producer;
	k_thread consumer;

	auto tid1 =
		k_thread_create(&producer, stack1, K_THREAD_STACK_SIZEOF(stack1), ThreadProducer,
				static_cast<void *>(&cb), NULL, NULL, 5, 0, K_NO_WAIT);
	auto tid2 =
		k_thread_create(&consumer, stack2, K_THREAD_STACK_SIZEOF(stack2), ThreadConsumer,
				static_cast<void *>(&cb), NULL, NULL, 5, 0, K_NO_WAIT);

	k_thread_start(tid1);
	k_thread_start(tid2);

	k_thread_join(tid1, K_FOREVER);
	k_thread_join(tid2, K_FOREVER);

	cb.Close();
}
```

## src/circular_buffer.hpp
```c
#pragma once

#include <unistd.h>
#include <string.h>
#include <errno.h>
#include <zephyr/kernel.h>

template <typename T> class CircularBuffer
{
      private:
	T *buffer_; // buffer pointer
	size_t capacity_;
	size_t write_index_;
	size_t read_index_;
	bool is_initialized_;

      public:
	CircularBuffer(size_t capacity)
		: capacity_(capacity), write_index_(0), read_index_(0), is_initialized_(false)
	{
	}

	int Open() noexcept
	{
		if (is_initialized_) {
			return -EEXIST;
		}
		write_index_ = 0;
		read_index_ = 0;
		is_initialized_ = true;

		buffer_ = static_cast<T *>(k_malloc(capacity_ * sizeof(T)));
		if (buffer_ == NULL) {
			return -EAGAIN;
		}
		return 0;
	}

	int Close() noexcept
	{
		if (!is_initialized_) {
			return -ENOENT;
		}
		is_initialized_ = false;
		k_free(static_cast<void *>(buffer_));
		return 0;
	}

	int Write(T &elem) noexcept
	{
		if (!IsInitialized()) {
			return -EEXIST;
		}
		if (IsFull()) {
			return -ENOBUFS;
		}

		memcpy(&buffer_[write_index_], &elem, sizeof(T));
		write_index_++;
		return 0;
	}

	ssize_t Write(T *elem, size_t num) noexcept
	{
		if (!IsInitialized()) {
			return -EEXIST;
		}

		int i;
		for (i = 0; i < num; ++i) {
			auto err = Write(elem[i]);
			if (err != 0) {
				assert(err == -ENOBUFS);
				break;
			}
		}
		return i + 1;
	}

	int Read(T &elem) noexcept
	{
		if (!IsInitialized()) {
			return -EEXIST;
		}
		if (IsEmpty()) {
			return -ENODATA;
		}

		memmove(&elem, &buffer_[read_index_], sizeof(T));
		read_index_++;
		return 0;
	}

	ssize_t Read(T *elem, size_t num) noexcept
	{
		if (!IsInitialized()) {
			return -EEXIST;
		}

		int i;
		for (i = 0; i < num; ++i) {
			auto err = Read(elem[i]);
			if (err != 0) {
				assert(err == -ENODATA);
				break;
			}
		}
		return i + 1;
	}

	size_t GetCapacity() const noexcept
	{
		return capacity_;
	}

	size_t GetSize() const noexcept
	{
		return write_index_ - read_index_;
	}

	bool IsFull() const noexcept
	{
		return GetSize() == GetCapacity();
	}

	bool IsEmpty() const noexcept
	{
		return GetSize() == 0;
	}

	bool IsInitialized() const noexcept
	{
		return is_initialized_;
	}
};

void TestCircularBuffer();
void TestCircularBufferMultithreading(k_thread_stack_t *, k_thread_stack_t *);
```

## src/event_logger.hpp
```c
#pragma once

#include <cstdint>

#include <zephyr/kernel.h>
#include <zephyr/logging/log.h>

#include "circular_buffer.hpp"

enum class EventId : std::uint16_t {
	NONE = 0,
	START_UP,
	SHUT_DOWN,
	START_READING,
	START_WRITING,
	STOP_READING,
	STOP_WRITING,
	MAX,
};

struct Event {
	EventId id: 16;
	std::uint64_t timestamp: 48;
};

class EventLogger
{
      private:
	CircularBuffer<Event> cb_;

      public:
	EventLogger(int size) : cb_(size)
	{
	}

	bool log(EventId id)
	{
		// LOG_DBG("EventId=%d", static_cast<int>(id));
		LOG_DBG("EventId");
		Event ev;
		ev.id = id;
		ev.timestamp = k_cycle_get_64();
		return cb_.write(ev);
	}

	Event get()
	{
		Event ev;
		auto result = cb_.read(ev);
		if (!result) {
			ev.id = EventId::NONE;
		}
		return ev;
	}
};
```
